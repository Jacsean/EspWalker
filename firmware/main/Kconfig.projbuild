## firmware/main/Kconfig.projbuild
```kconfig
menu "Esp32Walker App Config"

    choice APP_ROLE
        prompt "Board role"
        default APP_ROLE_MASTER
        config APP_ROLE_MASTER
            bool "Master (ES3N28P interaction board)"
        config APP_ROLE_MOTION
            bool "Motion (GOOUUU ESP32-S3 CAM board)"
    endchoice

    config APP_CHASSIS_TYPE
        string "Chassis type (diff2 / track / mecanum)"
        default "diff2"

    config APP_ENABLE_CAMERA
        bool "Enable camera capture (OV2640 / OV3660)"
        default n

    choice APP_CAMERA_SENSOR
        prompt "Camera sensor model"
        default APP_CAMERA_SENSOR_AUTO
        config APP_CAMERA_SENSOR_AUTO
            bool "Auto detect (OV2640 / OV3660)"
        config APP_CAMERA_SENSOR_OV2640
            bool "OV2640"
        config APP_CAMERA_SENSOR_OV3660
            bool "OV3660"
    endchoice

    config APP_ENABLE_AUDIO
        bool "Enable I2S audio capture/playback"
        default n

    config APP_ENABLE_WAKE
        bool "Enable ESP-SR wake word (requires esp-sr component)"
        default n

    config APP_ENABLE_STATUS_LED
        bool "Enable status LED"
        default y

    config APP_WIFI_SSID
        string "Wi-Fi SSID"
        default "your-ssid"

    config APP_WIFI_PASS
        string "Wi-Fi password"
        default "your-pass"

    config APP_SERVER_IP
        string "Center host IP address"
        default "192.168.1.100"

    config APP_SERVER_PORT
        int "Center host TCP port"
        default 8888

    config APP_PROX_STOP_CM
        int "Obstacle stop distance (cm)"
        default 15

    config APP_PROX_SLOW_CM
        int "Obstacle slow-down distance (cm)"
        default 30

    # --- 电机引脚 ---
    config APP_MOTOR1_PWM_GPIO
        int "Motor1 PWM GPIO"
        default 4
    config APP_MOTOR1_IN1_GPIO
        int "Motor1 IN1 GPIO"
        default 8
    config APP_MOTOR1_IN2_GPIO
        int "Motor1 IN2 GPIO"
        default 9
    config APP_MOTOR2_PWM_GPIO
        int "Motor2 PWM GPIO"
        default 5
    config APP_MOTOR2_IN1_GPIO
        int "Motor2 IN1 GPIO"
        default 10
    config APP_MOTOR2_IN2_GPIO
        int "Motor2 IN2 GPIO"
        default 11
    config APP_MOTOR3_PWM_GPIO
        int "Motor3 PWM GPIO (mecanum)"
        default 6
    config APP_MOTOR3_IN1_GPIO
        int "Motor3 IN1 GPIO (mecanum)"
        default 12
    config APP_MOTOR3_IN2_GPIO
        int "Motor3 IN2 GPIO (mecanum)"
        default 13
    config APP_MOTOR4_PWM_GPIO
        int "Motor4 PWM GPIO (mecanum)"
        default 7
    config APP_MOTOR4_IN1_GPIO
        int "Motor4 IN1 GPIO (mecanum)"
        default 14
    config APP_MOTOR4_IN2_GPIO
        int "Motor4 IN2 GPIO (mecanum)"
        default 15

    # --- 障碍感知 ---
    config APP_USE_TOF
        bool "Use VL53L0X TOF (I2C) instead of ultrasonic"
        default n
    config APP_ULTRASONIC_TRIG_GPIO
        int "Ultrasonic Trig GPIO"
        default 16
    config APP_ULTRASONIC_ECHO_GPIO
        int "Ultrasonic Echo GPIO"
        default 17
    config APP_I2C_SDA_GPIO
        int "I2C SDA GPIO (TOF)"
        default 41
    config APP_I2C_SCL_GPIO
        int "I2C SCL GPIO (TOF)"
        default 42

    # --- IMU ---
    config APP_ENABLE_IMU
        bool "Enable IMU (MPU6050 / MPU9250 on I2C)"
        default y
    config APP_IMU_TYPE
        int "IMU type (0=MPU6050, 1=MPU9250)"
        default 0
    config APP_IMU_ADDR
        hex "IMU I2C address"
        default 0x68

    # --- 音频 ---
    config APP_MIC_WS_GPIO
        int "INMP441 I2S WS GPIO"
        default 2
    config APP_MIC_SCK_GPIO
        int "INMP441 I2S SCK GPIO"
        default 3
    config APP_MIC_SD_GPIO
        int "INMP441 I2S SD GPIO"
        default 46
    config APP_SPK_BCLK_GPIO
        int "MAX98357A I2S BCLK GPIO"
        default 18
    config APP_SPK_LRC_GPIO
        int "MAX98357A I2S LRC GPIO"
        default 19
    config APP_SPK_DIN_GPIO
        int "MAX98357A I2S DIN GPIO"
        default 20

    # --- 按钮 / LED ---
    config APP_BTN_GPIO
        int "Capture button GPIO"
        default 0
    config APP_LED_GPIO
        int "Status LED GPIO"
        default 21

endmenu
```

## firmware/sdkconfig.defaults
```kconfig
# Esp32Walker 项目基线配置（会覆盖为 sdkconfig）
# 引脚默认值见 main/Kconfig.projbuild；此处只固化关键项。

# --- 芯片与 Flash ---
CONFIG_IDF_TARGET="esp32s3"
CONFIG_ESPTOOLPY_FLASHSIZE_16MB=y
CONFIG_ESPTOOLPY_FLASHMODE_QIO=y
CONFIG_ESPTOOLPY_FLASHFREQ_80M=y

# --- 分区表 ---
CONFIG_PARTITION_TABLE_CUSTOM=y
CONFIG_PARTITION_TABLE_CUSTOM_FILENAME="partitions.csv"

# --- PSRAM（摄像头帧缓冲必需）---
CONFIG_SPIRAM=y
CONFIG_SPIRAM_MODE_OCT=y
CONFIG_SPIRAM_SPEED_80M=y
CONFIG_SPIRAM_USE_MALLOC=y

# --- 日志 ---
CONFIG_LOG_DEFAULT_LEVEL_INFO=y
CONFIG_LOG_MAXIMUM_LEVEL_DEBUG=y

# --- 任务栈与稳定性 ---
CONFIG_ESP_MAIN_TASK_STACK_SIZE=8192
CONFIG_FREERTOS_CHECK_STACKOVERFLOW_CANARY=y
CONFIG_FREERTOS_INTERRUPT_BACKTRACE=y

# --- Esp32Walker 应用开关 ---
CONFIG_APP_ROLE_MASTER=y
CONFIG_APP_CHASSIS_TYPE="diff2"
CONFIG_APP_ENABLE_CAMERA=n
CONFIG_APP_ENABLE_AUDIO=n
CONFIG_APP_ENABLE_WAKE=n
CONFIG_APP_ENABLE_STATUS_LED=y
CONFIG_APP_ENABLE_IMU=y

# --- 网络（改这里，或 menuconfig）---
CONFIG_APP_WIFI_SSID="your-ssid"
CONFIG_APP_WIFI_PASS="your-pass"
CONFIG_APP_SERVER_IP="192.168.1.100"
CONFIG_APP_SERVER_PORT=8888

# --- 避障阈值（cm）---
CONFIG_APP_PROX_STOP_CM=15
CONFIG_APP_PROX_SLOW_CM=30
```
